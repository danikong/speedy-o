#include "speedy_o.dtsi"

&default_transform {
    col-offset = <6>;
};

&default_kscan {
    col-gpios = <&gpio1 13 GPIO_ACTIVE_HIGH>,
                <&gpio1 15 GPIO_ACTIVE_HIGH>,
                <&gpio0 24 GPIO_ACTIVE_HIGH>,
                <&gpio0 22 GPIO_ACTIVE_HIGH>,
                <&gpio0 20 GPIO_ACTIVE_HIGH>;
};



