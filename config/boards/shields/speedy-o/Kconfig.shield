## config/boards/shields/speedy-o/Kconfig.shield
```kconfig
config SHIELD_SPEEDY_O_LEFT
    def_bool $(shields_list_contains,speedy_o_left)

config SHIELD_SPEEDY_O_RIGHT
    def_bool $(shields_list_contains,speedy_o_right)
```

## zmk/config/boards/shields/speedy-o/Kconfig.defconfig
```kconfig
if SHIELD_SPEEDY_O_LEFT

config ZMK_KEYBOARD_NAME
    default "Speedy-O"

config ZMK_SPLIT_ROLE_CENTRAL
    default y

endif

if SHIELD_SPEEDY_O_LEFT || SHIELD_SPEEDY_O_RIGHT

config ZMK_SPLIT
    default y

endif
```
