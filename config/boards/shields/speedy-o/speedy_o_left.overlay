#include "speedy_o.dtsi"

// | 0.20 | 0.22 | 0.24 | 1.15 | 1.13 | 1.11 |   | 1.11 | 1.13 | 1.15 | 0.24 | 0.22 | 0.20 |
&default_kscan {
    col-gpios = <&gpio0 20 GPIO_ACTIVE_HIGH>,
                <&gpio0 22 GPIO_ACTIVE_HIGH>,
                <&gpio0 24 GPIO_ACTIVE_HIGH>,
                <&gpio1 15 GPIO_ACTIVE_HIGH>,
                <&gpio1 13 GPIO_ACTIVE_HIGH>;
                <&gpio1 11 GPIO_ACTIVE_HIGH>;
};

&pro_micro {
    led_strip: ws2812@0 {
        compatible = "worldsemi,ws2812-gpio";
        label = "LED_STRIP";
        chain-length = <27>;  // Adjust to the number of LEDs in your setup
        color-order = "GRB";  // Color order for WS2812 LEDs
        gpios = <&gpio0 2 GPIO_ACTIVE_HIGH>;  // P0.02 for the data line
    };
};
